## CMakeLists.txt
```
cmake_minimum_required(VERSION 3.20.0)
find_package(Zephyr REQUIRED HINTS $ENV{ZEPHYR_BASE})
project(nrf_connect_sdk_fundamentals)

target_sources(app PRIVATE src/main.c)
target_sources(app PRIVATE src/stb_scheduler.c)
target_sources(app PRIVATE src/RTDB.c)
target_sources(app PRIVATE src/functions.c)
# target_sources(app PRIVATE tests/stbs_test.c)
```

## prj.conf
```kconfig
CONFIG_GPIO=y


CONFIG_SERIAL=y
CONFIG_UART_ASYNC_API=y
CONFIG_UART_CONSOLE=y
CONFIG_PRINTK=y
CONFIG_TIMING_FUNCTIONS=y
CONFIG_HEAP_MEM_POOL_SIZE=4096
```

## src/main.c
```c
/**
 * @file
 * @brief Static Table-Based Scheduler (STBS) Example
 *
 * This file demonstrates a simple STBS implementation for Zephyr.
 * The scheduler uses a static table to manage tasks and activates them periodically.
 */

#include <sys/_intsup.h>
#include <zephyr/kernel.h>
#include <zephyr/kernel/thread_stack.h>
#include <zephyr/sys/printk.h>
#include <stdlib.h>
#include <string.h>
#include <ctype.h>
#include "zephyr/kernel/thread.h"
#include <zephyr/timing/timing.h>   /* for timing services */
#include <zephyr/device.h>
#include <zephyr/devicetree.h>
#include <zephyr/drivers/gpio.h>
#include <zephyr/drivers/uart.h>


// helper functions
#include "../include/functions.h"
#include "../include/stb_scheduler.h"
#include "../include/frames.h"
#include "../include/rtdb.h"
#include "zephyr/sys/sys_io.h"

// GLOBAL

RT_db rtdb;

/************************************  UART  ***********************************/
#define SLEEP_TIME_MS 1000
#define RECEIVE_BUFF_SIZE 10
#define RECEIVE_TIMEOUT 100
#define INPUT_BUFFER_SIZE 20




// LEDS
static const struct gpio_dt_spec led0 = GPIO_DT_SPEC_GET(DT_ALIAS(led0), gpios);
static const struct gpio_dt_spec led1 = GPIO_DT_SPEC_GET(DT_ALIAS(led1), gpios);
static const struct gpio_dt_spec led2 = GPIO_DT_SPEC_GET(DT_ALIAS(led2), gpios);
static const struct gpio_dt_spec led3 = GPIO_DT_SPEC_GET(DT_ALIAS(led3), gpios);

// BUTTONS
static const struct gpio_dt_spec button0 = GPIO_DT_SPEC_GET(DT_ALIAS(sw0), gpios);
static const struct gpio_dt_spec button1 = GPIO_DT_SPEC_GET(DT_ALIAS(sw1), gpios);
static const struct gpio_dt_spec button2 = GPIO_DT_SPEC_GET(DT_ALIAS(sw2), gpios);
static const struct gpio_dt_spec button3 = GPIO_DT_SPEC_GET(DT_ALIAS(sw3), gpios);



const struct device *uart= DEVICE_DT_GET(DT_NODELABEL(uart0));

/************************** FRAME PROCESSING ******************************/

/**
 * Process a frame received over UART.
 * @param frame Frame to process
 * @param frame_length Length of the frame
 * @param checksum Checksum of the frame
 * @param checksum Checksum of the frame
 */
void process_frame(const char *frame, int frame_length) {

    if(!strcmp(frame,"!PO13#")){
        frame = "!PO53#";      // change a character to simulate corrupted data 
        // printk("new frame: %s\n",frame);
    }
    // Validate frame structure
    if (frame_length < 5 || frame[0] != '!' || frame[frame_length - 1] != '#' ||
        !isdigit(frame[frame_length - 4]) ||
        !isdigit(frame[frame_length - 3]) ||
        !isdigit(frame[frame_length - 2])) {
        send_ack('4'); // Frame structure error
        return;
    }


    // Extract command and payload
    char device_id = frame[1];
    char command = frame[2];

    const char *checksum = &frame[frame_length - 4];

    
    int received_checksum = atoi(checksum);
    // Calculate and validate checksum!

    if (calculate_checksum(frame, frame_length-4) != received_checksum) {
        printk("Received checksum: %d  Calculated checksum: %d\n", received_checksum,calculate_checksum(frame, frame_length - 4));
        send_ack('3'); // Checksum error
        return;
    }

    // Process command
    switch (command) {
    case 'O': // Set individual LED
        char payloadA[2];
        memcpy(payloadA, &frame[3], frame_length - 7);
        if (payloadA[0] >= '1' && payloadA[0] <= '4' &&
            (payloadA[1] == '0' || payloadA[1] == '1')) {
            set_led(payloadA[0]-'1', payloadA[1]-'0');
            send_ack('1'); // Acknowledge success
        } else {
            send_ack('4'); // Invalid payload
        }
        break;

    case 'A': // Set all LEDs (atomic operation)
        char payloadB [4];
        memcpy(payloadB, &frame[3], frame_length - 7);  
        
        if (validate_led_states(payloadB)) {
            for (int i = 0; i < 4; i++) {
                set_led(i, payloadB[i]-'0');
            }
            send_ack('1'); // Acknowledge success
        } else {
            send_ack('4'); // Invalid payload
        }
        break;

    case 'I': // Read digital inputs
        send_inputs();
        break;

    case 'E': // Read digital outputs
        send_outputs();
        break;

    case 'C':
        rtdb.led0 = -1;
        break;

    default:
        send_ack('2'); // Unknown command
        break;
    }
}

/**
 * Calculate the checksum of a frame.
 * The checksum is the sum of all bytes in the frame, excluding the checksum itself.
 * @param frame Frame to calculate checksum for
 * @param length Length of the frame
 * @return Checksum of the frame
 */
int calculate_checksum(const char *frame, int length) {
    int checksum = 0;
    for (int i = 1; i < length; i++) {
        checksum += frame[i];
    
    }
    return checksum % 1000; // Return last 3 digits
}

/**
 * Send an acknowledgment frame over UART.
 * @param error_code Error code to send in the acknowledgment frame
 */
void send_ack(char error_code) {
    static char ack_frame[20]; // Ensure a static buffer is used
    snprintf(ack_frame, sizeof(ack_frame), "!MZO%c000#", error_code);

    int checksum = calculate_checksum(ack_frame, strlen(ack_frame) - 4);
    ack_frame[5] = '0' + (checksum / 100);
    ack_frame[6] = '0' + ((checksum / 10) % 10);
    ack_frame[7] = '0' + (checksum % 10);
    
    int ret = uart_tx(uart, ack_frame, strlen(ack_frame), SYS_FOREVER_MS);
    if (ret != 0) {
        printk("UART TX failed with error: %d\n", ret);
    }
}


/**
 * Set the state of an LED.
 * @param led_index Index of the LED (0-3)
 * @param value New state of the LED (0 or 1)
 */
void set_led(int led_index, int value) {
    switch (led_index) {
    case 0: rtdb.led0 = value; break;
    case 1: rtdb.led1 = value; break;
    case 2: rtdb.led2 = value; break;
    case 3: rtdb.led3 = value; break;
    default: break;
    }
}

/**
 * Validate the payload of an "A" command.
 * The payload must be a 4-character string containing only '0' and '1' characters.
 */
bool validate_led_states(const char *payload) {
    for (int i = 0; i < 4; i++) {
        if (payload[i] != '0' && payload[i] != '1') {
            return false;
        }
    }
    return true;
}

/**
 * Send the current state of the buttons over UART.
 */
void send_inputs() {
    static char input_frame[] = "!Mi0000####";
    input_frame[3] = '0' + rtdb.button0;
    input_frame[4] = '0' + rtdb.button1;
    input_frame[5] = '0' + rtdb.button2;
    input_frame[6] = '0' + rtdb.button3;

    // Update checksum
    int checksum = calculate_checksum(input_frame, strlen(input_frame) - 4);
    input_frame[7] = '0' + (checksum / 100); // Hundreds place
    input_frame[8] = '0' + ((checksum / 10) % 10); // Tens place
    input_frame[9] = '0' + (checksum % 10); // Units place

    int err = uart_tx(uart, input_frame, strlen(input_frame), SYS_FOREVER_MS);
    if (err) {
        printk("uart_tx() error. Error code:%d\n\r",err);
        return;
    }
}

/**
 * Send the current state of the LEDs over UART.
 */
void send_outputs() {
    static char output_frame[] = "!Me0000####";
    output_frame[3] = '0' + rtdb.led0;
    output_frame[4] = '0' + rtdb.led1;
    output_frame[5] = '0' + rtdb.led2;
    output_frame[6] = '0' + rtdb.led3;

    // Update checksum
    int checksum = calculate_checksum(output_frame, strlen(output_frame) - 4);
    output_frame[7] = '0' + (checksum / 100); // Hundreds place
    output_frame[8] = '0' + ((checksum / 10) % 10); // Tens place
    output_frame[9] = '0' + (checksum % 10); // Units place

    int err = uart_tx(uart, output_frame, strlen(output_frame), SYS_FOREVER_MS);
    if (err) {
        printk("uart_tx() error. Error code:%d\n\r",err);
        return;
    }
}


/************************** UART ******************************/

// static uint8_t tx_buf[] =   {"nRF Connect SDK Fundamentals Course\r\n"
//                             "Press 1-3 on your keyboard to toggle LEDS 1-3 on your development kit\r\n"};

static uint8_t rx_buf[RECEIVE_BUFF_SIZE] = {0};
static char buffer[INPUT_BUFFER_SIZE];
static int buffer_idx = 0;
static void uart_cb(const struct device *dev, struct uart_event *evt, void *user_data) {
    static char frame_buffer[INPUT_BUFFER_SIZE] = {0}; // Frame buffer
    static int frame_idx = 0;

    switch (evt->type) {
    case UART_RX_RDY:
        for (size_t i = 0; i < evt->data.rx.len; i++) {
            char received_char = evt->data.rx.buf[evt->data.rx.offset + i];
            if (frame_idx == 0 && received_char == '!') { // Start of frame
                memset(frame_buffer, 0, INPUT_BUFFER_SIZE);
                frame_buffer[frame_idx++] = received_char;
                printk("%c", received_char);
            }
            else if(frame_idx>0) {
                printk("%c", received_char);
                frame_buffer[frame_idx++] = received_char;
                if (received_char == '#') { // End of frame
                    printk("\n");
                    // put the checksum in the buffer before the '#'
                    // int checksum = calculate_checksum(frame_buffer, frame_idx - 1);

                    process_frame(frame_buffer, frame_idx); // Process the frame
                    frame_idx = 0;
                }
            }
        }
        break;

    case UART_RX_DISABLED:
        uart_rx_enable(dev, rx_buf, sizeof(rx_buf), RECEIVE_TIMEOUT);
        break;

    default:
        break;
    }
}






/************************** THREADS ******************************/

// Configuration constants
#define TICK_MS 50          // Scheduler tick period in milliseconds
#define MAX_TASKS 15

extern const k_tid_t thread0,thread1,thread2,thread3;


/**
 * Task 0: Periodic task with period 1 tick
 * this task is responsible for updating the RTDB with the button states
 */
void task0(void *argA, void *argB, void *argC) {
    // k_tid_t task_id = *(k_tid_t *)id_ptr; // Retrieve task ID
    while (1) {
        
        k_thread_suspend(thread0);
        int timer1 = k_uptime_get();
        // printk("T0->timer1: %d\n",timer1);
        gpio_pin_set_dt(&led0,rtdb.led0);
        gpio_pin_set_dt(&led1,rtdb.led1);
        gpio_pin_set_dt(&led2,rtdb.led2);
        gpio_pin_set_dt(&led3,rtdb.led3);

        rtdb.button0 = gpio_pin_get_dt(&button0); // Read button0 state
        rtdb.button1 = gpio_pin_get_dt(&button1); // Read button1 state
        rtdb.button2 = gpio_pin_get_dt(&button2); // Read button2 state
        rtdb.button3 = gpio_pin_get_dt(&button3); // Read button3 state
    
        int timer2 = k_uptime_get();
        // printk("T0->timer2: %d\n",timer2);
        // printk("Task0 execution time: %d\n",timer2-timer1);
        // RT_db_print(&rtdb);
        // gpio_pin_set_dt(&led3,rtdb.led3);
        // printk("Task0 executing %d\n",thread0); // Simulate task behavior
    }
}


/**
 * Task 1: Periodic task with period 2 ticks
 * this task is responsible for updating the led states based on the button states from the RTDB
 */
void task1(void *argA, void *argB, void *argC) {
    // k_tid_t task_id = *(k_tid_t *)id_ptr; // Retrieve task ID
    static int prev_button0 = 0;
    static int prev_button1 = 0;
    static int prev_button2 = 0;
    static int prev_button3 = 0;
    while (1) {
        k_thread_suspend(thread1);
        int timer1 = k_uptime_get();
        // printk("T1->timer1: %d\n",timer1);
        // based on the button state,change the led state once
        if(rtdb.button0 == 1 && prev_button0 == 0){
            rtdb.led0 = !rtdb.led0;
        }
        if(rtdb.button1 == 1 && prev_button1 == 0){
            rtdb.led1 = !rtdb.led1;
        }
        if(rtdb.button2 == 1 && prev_button2 == 0){
            rtdb.led2 = !rtdb.led2;
        }
        if(rtdb.button3 == 1 && prev_button3 == 0){
            rtdb.led3 = !rtdb.led3;
        }

        prev_button0 = rtdb.button0;
        prev_button1 = rtdb.button1;
        prev_button2 = rtdb.button2;
        prev_button3 = rtdb.button3;

        int timer2 = k_uptime_get();
        // printk("T1->timer2: %d\n",timer2);
        // printk("Task1 execution time: %d\n",timer2-timer1);

        // k_msleep(TICK_MS); // Simulate work
    }
}

// Validate rtdb entries and reset them if they are corrupted
void task2(void *argA, void *argB, void *argC) {
    // k_tid_t task_id = *(k_tid_t *)id_ptr; // Retrieve task ID
    while (1) {
        k_thread_suspend(thread2);

        int timer1 = k_uptime_get();
        // printk("T2->timer1: %d\n",timer1);
        if(rtdb.button0 != 0 && rtdb.button0 != 1) {rtdb.button0 = 0; printk("corrupted data\n");}
        if(rtdb.button1 != 0 && rtdb.button1 != 1) {rtdb.button1 = 0; printk("corrupted data\n");}
        if(rtdb.button2 != 0 && rtdb.button2 != 1) {rtdb.button2 = 0; printk("corrupted data\n");}
        if(rtdb.button3 != 0 && rtdb.button3 != 1) {rtdb.button3 = 0; printk("corrupted data\n");}

        if(rtdb.led0 != 0 && rtdb.led0 != 1) {rtdb.led0 = 0; printk("corrupted data\n");}
        if(rtdb.led1 != 0 && rtdb.led1 != 1) {rtdb.led1 = 0; printk("corrupted data\n");}
        if(rtdb.led2 != 0 && rtdb.led2 != 1) {rtdb.led2 = 0; printk("corrupted data\n");}
        if(rtdb.led3 != 0 && rtdb.led3 != 1) {rtdb.led3 = 0; printk("corrupted data\n");}
        int timer2 = k_uptime_get();
        // printk("T2->timer1: %d\n",timer2);
        // printk("Task2 execution time: %d\n",timer2-timer1);

        // k_msleep(TICK_MS); // Simulate work
    }
}

void task3(void *argA, void *argB, void *argC) {
    // k_tid_t task_id = *(k_tid_t *)id_ptr; // Retrieve task ID
    while (1) {
        k_thread_suspend(thread3);
        //printk("Task3 executing %d\n",thread3); // Simulate task behavior
        // k_msleep(TICK_MS); // Simulate work
    }
}

/*
 * defining threads
*/
K_THREAD_DEFINE(thread0 , 512, task0, NULL, NULL, NULL,5,0,0);
K_THREAD_DEFINE(thread1, 512, task1, NULL, NULL, NULL,5,0,0);
K_THREAD_DEFINE(thread2, 512, task2, NULL, NULL, NULL,1,0,0);
K_THREAD_DEFINE(thread3, 512, task3, NULL, NULL, NULL,5,0,0);

/**
 * Main function demonstrating the Static Table-Based Scheduler (STBS).
 */
int main(void) {
    printk("Zephyr STBS Example\n");

    uint8_t msg[INPUT_BUFFER_SIZE];
    int ret;

	/* Verify that the UART device is ready */
	if (!device_is_ready(uart)){
		printk("UART device not ready\r\n");
		return 1 ;
	}
	/* Verify that the LED devices are ready */
	if (!device_is_ready(led0.port)){
		printk("GPIO device is not ready\r\n");
		return 1;
	}
	/* Configure the GPIOs of the LEDs */
	ret = gpio_pin_configure_dt(&led0, GPIO_OUTPUT_ACTIVE);
	if (ret < 0) {
		return 1 ; 
	}
	ret = gpio_pin_configure_dt(&led1, GPIO_OUTPUT_ACTIVE);
	if (ret < 0) {
		return 1 ;
	}
	ret = gpio_pin_configure_dt(&led2, GPIO_OUTPUT_ACTIVE);
	if (ret < 0) {
		return 1 ;
	}
    ret = gpio_pin_configure_dt(&led3, GPIO_OUTPUT_ACTIVE);
    if (ret < 0) {
        return 1 ;
    }

    /* Configure the GPIOs of the buttons */
    ret = gpio_pin_configure_dt(&button0, GPIO_INPUT);
    if (ret < 0) {
        return 1 ;
    }

    ret = gpio_pin_configure_dt(&button1, GPIO_INPUT);
    if (ret < 0) {
        return 1 ;
    }

    ret = gpio_pin_configure_dt(&button2, GPIO_INPUT);
    if (ret < 0) {
        return 1 ;
    }

    ret = gpio_pin_configure_dt(&button3, GPIO_INPUT);
    if (ret < 0) {
        return 1 ;
    }


	/* Register the UART callback function */
	ret = uart_callback_set(uart, uart_cb, NULL);
	if (ret) {
		return 1;
	}
	/* Send the data over UART by calling uart_tx() */
	// ret = uart_tx(uart, tx_buf, sizeof(tx_buf), SYS_FOREVER_US);
	// if (ret) {
	// 	return 1;
	// }
	/* Start receiving by calling uart_rx_enable() and pass it the address of the receive buffer */
	ret = uart_rx_enable(uart ,rx_buf,sizeof(rx_buf),RECEIVE_TIMEOUT);
	if (ret) {
		return 1;
	}


    RT_db_init(&rtdb);



    // Initialize the scheduler
    STBS_Init(TICK_MS,MAX_TASKS);

    // Add tasks with different periods
    // STBS_AddTask(1, thread0, 1,40,"thread0"); // Task 1: Period = 1 ticks
    // STBS_AddTask(3, thread2, 1,120,"thread2"); // Task 3: Period = 3 ticks
    // STBS_AddTask(2, thread1, 1,160,"thread1"); // Task 2: Period = 2 tick
    // STBS_AddTask(2, thread3, 1,40,"thread3"); // Task 2: Period = 2 tick

    STBS_AddTask(1, thread0, 1,3,"thread0"); // Task 1: Period = 1 ticks
    STBS_AddTask(2, thread1, 2,3,"thread1"); // Task 2: Period = 2 tick
    STBS_AddTask(2, thread2, 1,3,"thread2"); // Task 3: Period = 3 ticks

    // STBS_AddTask(1, thread0, 10,40,"thread0"); // Task 1: Period = 1 ticks
    // STBS_AddTask(3, thread2, 5,50,"thread2"); // Task 3: Period = 3 ticks
    // STBS_AddTask(2, thread1, 7,60,"thread1"); // Task 2: Period = 2 tick
    // STBS_AddTask(2, thread3, 2,30,"thread3"); // Task 2: Period = 2 tick

    // STBS_print_content();
    // Start the scheduler
    STBS_Start();
    return 0;
}
```

## include/functions.h
```c
#include "zephyr/kernel/thread.h"
#include <zephyr/kernel.h>

#ifndef FUNCTIONS_H
#define FUNCTIONS_H

#define NS_IN_SEC 1000000000L



typedef struct {
    k_tid_t id;                      // Unique identifier for the task
    int ticks;                   // Task's period in ticks (relative to the scheduler's tick)
    int next_activation;         // Tick count for the next activation of the task
    int priority;                // Priority level of the thread (lower values = higher priority in Zephyr)
    int exec_time;              // execution time in ms
    int to_be_executed;         // flag that says if the task was supposed to be executed in a previous tick, but it didnt have enough time left
    int delay_count;            // CHANGED! It counts the number of times a task was put to execute in the next clock cycle
    char *name;
} Task;

int compare_tasks(const void *a,const void *b);
int gcd(int a, int b);
int lcm(int a, int b);
int lcm_array(int arr[], int n);

#endif
```

## include/rtdb.h
```c
#ifndef RTDB_H
#define RTDB_H

// realtime database


typedef struct {
    // leds
    int led0;
    int led1;
    int led2;
    int led3;

    // buttons
    int button0;
    int button1;
    int button2;
    int button3;

} RT_db;


// Function to initialize the database
void RT_db_init(RT_db *db);
int RT_db_update(RT_db *db, char* command);
void RT_db_print(RT_db *db);

#endif // RTDB_H
```

## include/stb_scheduler.h
```c
#include "functions.h"

#ifndef STB_SCHEDULER_H
#define STB_SCHEDULER_H


// Scheduler structure to manage tasks and execution
typedef struct {
    int tick_ms;                 // Scheduler tick duration in milliseconds
    Task *task_table;  // Array of tasks
    int max_tasks;               // Maximum number of tasks allowed
    int num_tasks;               // Current number of tasks
    int macro_cycle;              // Macrocycle duration (in ticks)
} STB_scheduler;

typedef struct{
    // int tick;               // current tick
    Task *tasks;  // ids of the tasks that will execute in this tick
    int num_tasks;          // number of tasks to execute in this tick
    int total_exec_time;    // total time it takes for the tasks to execute
}scheduler_table_entry;


void STBS_Init(int tick_ms, int max_tasks);
void STBS_AddTask(int ticks, k_tid_t task_id, int priority, int execution_time, char *name);
void STBS_print_content();
void STBS_Start();

// for testing
int STBS_GetNumTasks(void);
int STBS_GetTickMs(void);
const Task* STBS_GetTaskTable(void);
int STBS_GetMacroCycle(void);


#endif
```

## src/RTDB.c
```c
#include "../include/rtdb.h"
#include <string.h>

#define COMMANDS {"!PO11#", "!PO10#", "!PO21#", "!PO20#", "!PO31#", "!PO30#", "!PO41#", "!PO40#"}


void RT_db_init(RT_db *db){
    db->led0 = 0;
    db->led1 = 0;
    db->led2 = 0;
    db->led3 = 0;
    db->button0 = 0;
    db->button1 = 0;
    db->button2 = 0;
    db->button3 = 0;
}

int RT_db_update(RT_db *db, char *command){
    // check if the command is a valid command
    const char *valid_commands[] = COMMANDS;
    int is_valid_command = 0;
    for (int i = 0; i < sizeof(valid_commands) / sizeof(valid_commands[0]); i++) {
        if (strcmp(command, valid_commands[i]) == 0) {
            is_valid_command = 1;
            break;
        }
    }
    if (!is_valid_command) {

        return 0;
    }else{
        if(command[1] == 'P'){	// PC -> Microcontroller communication
            if(command[2] == 'O' && command[5]=='#'){ // turn on a LED
                if(command[3] == '1'){	// LED 1
                    if(command[4] == '1' ){ // turn on
                        db->led0 = 1;
                    } else if(command[4] == '0'){
                        db->led0 = 0;
                    }
                } else if(command[3] == '2'){	// LED 2
                    if(command[4] == '1' ){ // turn on
                        db->led1 = 1;
                    } else if(command[4] == '0'){
                        db->led1 = 0;
                    }
                } else if(command[3] == '3'){	// LED 3
                    if(command[4] == '1' ){ // turn on
                        db->led2 = 1;
                    } else if(command[4] == '0'){
                        db->led2 = 0;
                    }
                    
                }
                
            }
        return 1;
        }
    }
}

void RT_db_print(RT_db *db){
    printk("LED0: %d\n",db->led0);
    printk("LED1: %d\n",db->led1);
    printk("LED2: %d\n",db->led2);
    printk("LED3: %d\n",db->led3);
    printk("Button0: %d\n",db->button0);
    printk("Button1: %d\n",db->button1);
    printk("Button2: %d\n",db->button2);
    printk("Button3: %d\n",db->button3);
}
```

## src/functions.c
```c
#include "../include/functions.h"



int compare_tasks(const void *a,const void *b){
    const Task *taskA = (const Task *)a;
    const Task *taskB = (const Task *)b;

    if(taskA->priority != taskB->priority)  // Sort by priority
        return taskA->priority - taskB->priority;

    // If the priority is the same
    return taskA->ticks - taskB->ticks; // Sort by period
}

int gcd(int a, int b) {
    while (b != 0) {
        int temp = b;
        b = a % b;
        a = temp;
    }
    return a;
}

// Function to calculate LCM of two numbers
int lcm(int a, int b) {
    return (a * b) / gcd(a, b);
}

// Function to calculate LCM of an array of numbers
int lcm_array(int arr[], int n) {
    int result = arr[0];
    for (int i = 1; i < n; i++) {
        result = lcm(result, arr[i]);
    }
    return result;
}
```

## src/functions.h
```c
#define NS_IN_SEC 1000000000L



typedef struct {
    k_tid_t id;                      // Unique identifier for the task
    int ticks;                   // Task's period in ticks (relative to the scheduler's tick)
    int next_activation;         // Tick count for the next activation of the task
    // struct k_thread thread;      // Zephyr thread object to manage the task's execution
    // k_tid_t thread_id;           // Identifier for the thread
    int priority;                // Priority level of the thread (lower values = higher priority in Zephyr)
    int exec_time;              // execution time in ms
    int to_be_executed;         // flag that says if the task was supposed to be executed in a previous tick, but it didnt have space available
} Task;


int compare_tasks(const void *a,const void *b){
    const Task *taskA = (const Task *)a;
    const Task *taskB = (const Task *)b;

    if(taskA->priority != taskB->priority)  // Sort by priority
        return taskA->priority - taskB->priority;

    // If the priority is the same
    return taskA->ticks - taskB->ticks; // Sort by period
}

int gcd(int a, int b) {
    while (b != 0) {
        int temp = b;
        b = a % b;
        a = temp;
    }
    return a;
}

// Function to calculate LCM of two numbers
int lcm(int a, int b) {
    return (a * b) / gcd(a, b);
}

// Function to calculate LCM of an array of numbers
int lcm_array(int arr[], int n) {
    int result = arr[0];
    for (int i = 1; i < n; i++) {
        result = lcm(result, arr[i]);
    }
    return result;
}
```

## src/rtdb.h
```c
// realtime database


typedef struct {
    // leds
    int led0;
    int led1;
    int led2;
    int led3;

    // buttons
    int button0;
    int button1;
    int button2;
    int button3;

} RT_db;


// Function to initialize the database
void RT_db_init(RT_db *db);
int RT_db_update(RT_db *db, char* command);
void RT_db_print(RT_db *db);
```

## src/stb_scheduler.c
```c
#include "../include/stb_scheduler.h"
#include "../include/functions.h"

#include <stdlib.h>

static STB_scheduler stbs; // Global scheduler instance
static scheduler_table_entry *entry;

/**
 * @brief Initializes the STB scheduler.
 * @param tick_ms Tick duration in milliseconds.
 * @param max_tasks Maximum number of tasks that can be scheduled.
 */
void STBS_Init(int tick_ms, int max_tasks) {
    stbs.tick_ms = tick_ms;
    stbs.max_tasks = max_tasks;
    stbs.num_tasks = 0;
    stbs.task_table = k_malloc(max_tasks * sizeof(Task));
    // Initialize task table
    for (int i = 0; i < max_tasks; i++) {
        stbs.task_table[i].id = -1; // Mark as unused
        stbs.task_table[i].ticks = 0;
        stbs.task_table[i].next_activation = -1;
    }

    printk("STBS Initialized\n");
}

/**
 * @brief Adds a new task to the scheduler.
 * @param ticks Periodicity of the task in ticks.
 * @param task_id Task identifier (e.g., thread ID).
 * @param priority Task priority level.
 * @param execution_time Task execution time in ticks.
 * @param name Task name.
 */


/**
 * Adds a new task to the scheduler.
 */
void STBS_AddTask(int ticks, k_tid_t task_id, int priority, int execution_time, char *name) {
    if (stbs.num_tasks >= stbs.max_tasks) {
        printk("Error: Maximum task limit reached\n");
        return;
    }

    // Find an empty slot in the task table
    for (int i = 0; i < stbs.max_tasks; i++) {
        if (stbs.task_table[i].id == -1) {
            stbs.task_table[i].ticks = ticks;
            stbs.task_table[i].next_activation = ticks; // Set initial activation
            stbs.task_table[i].priority = priority;
            stbs.task_table[i].id = task_id;
            stbs.task_table[i].exec_time = execution_time;
            stbs.task_table[i].to_be_executed = 0;
            stbs.task_table[i].delay_count = 0;         // CHANGED
            stbs.task_table[i].name = name;
            

            stbs.num_tasks++;
            printk("Added Task %s with period %d ticks\n",name, ticks);
            break;
        }
    }
}

/**
 * @brief Schedules all the registered tasks and starts the scheduler .
 */
void STBS_Start() {
    int64_t fin_time=0, release_time=0;     /* Timing variables to control task periodicity */

    // Calculate macrocycle as the LCM of all task periods
    int task_ticks[stbs.max_tasks];
    for (int i = 0; i < stbs.num_tasks; i++) {
        task_ticks[i] = stbs.task_table[i].ticks;
    }
    stbs.macro_cycle = lcm_array(task_ticks, stbs.num_tasks);

    // Calculate the ticks in which each task will execute
    qsort(stbs.task_table,stbs.num_tasks,sizeof(Task),compare_tasks);

    // create the table with the times in which each task will execute
    // in the first tick, all taks are ready
    entry = k_malloc(stbs.macro_cycle * sizeof(scheduler_table_entry));
    if (!entry) {
        printk("Failed to allocate scheduler table\n");
        return;
    }

    // initialize table entries
    for(int j = 0; j< stbs.macro_cycle;j++){
        entry[j].num_tasks = 0;
        // entry[j].tick = j;
        entry[j].tasks = k_malloc(stbs.num_tasks*sizeof(Task));
        if (!entry[j].tasks) {
            printk("Failed to allocate memory for tasks at tick %d\n", j);
            // Free previously allocated entries to prevent memory leaks
            for (int k = 0; k < j; k++) {
                k_free(entry[k].tasks);
            }
            k_free(entry);
            return;
        }
        entry[j].total_exec_time = 0;

    }

    printk("Starting table computation\n");
    // create the actual table
    for(int tick = 0; tick < stbs.macro_cycle;tick++){

        for(int task_idx = 0; task_idx < stbs.num_tasks; task_idx++){
            if(tick == 0 || tick % stbs.task_table[task_idx].ticks == 0 || stbs.task_table[task_idx].to_be_executed){
                if(stbs.task_table[task_idx].exec_time + entry[tick].total_exec_time <= stbs.tick_ms){
                    entry[tick].tasks[entry[tick].num_tasks] = stbs.task_table[task_idx];
                    entry[tick].total_exec_time += stbs.task_table[task_idx].exec_time;
                    entry[tick].num_tasks++;
                    stbs.task_table[task_idx].to_be_executed = 0;
                    stbs.task_table[task_idx].delay_count = 0;    // CHANGED
                }
                else{
                    stbs.task_table[task_idx].delay_count += 1; // CHANGED
                    if(tick+1 > stbs.macro_cycle 
                     || stbs.task_table[task_idx].delay_count >= stbs.task_table[task_idx].ticks){ // CHANGED
                        printk("System not schedulable\n");
                        for (int i = 0; i < stbs.macro_cycle; i++) {
                            k_free(entry[i].tasks);
                        }
                        k_free(entry);
                        return;
                    }
                    stbs.task_table[task_idx].to_be_executed = 1;
                }
            }
        }
    }
    STBS_print_content();
    printk("Starting STBS\n");

    int current_tick = 0; // Keeps track of the current tick count
    k_msleep(20); // let the tasks arrive at the point where they suspend themselves
    while(1){
        release_time = k_uptime_get() + stbs.tick_ms;
        // uint64_t scheduler_start_time = k_uptime_get(); // Start measuring scheduler time

        for(int i = 0; i <stbs.macro_cycle;i++){
            current_tick++;
            // int n_executed_tasks = 0;

            // uint64_t iteration_start_time = k_uptime_get(); // Start timing the iteration

            for(int task_idx = 0; task_idx < entry[i].num_tasks; task_idx++){
                // uint64_t task_start_time = k_uptime_get(); // Time before resuming a task

                k_tid_t task_id = entry[i].tasks[task_idx].id;
                k_thread_resume(task_id);

                // uint64_t task_end_time = k_uptime_get(); // Time after resuming the task
                // n_executed_tasks++;

                // // Log task overhead if necessary
                // printk("Task %d resume time: %llu ms\n", task_idx, task_end_time - task_start_time);
            }

            // uint64_t iteration_end_time = k_uptime_get(); // End timing the iteration
            // printk("Macro cycle %d iteration overhead: %llu ms\n", i, iteration_end_time - iteration_start_time);

            fin_time = k_uptime_get();
            if( fin_time < release_time) {
                k_msleep(release_time - fin_time);
                release_time += stbs.tick_ms;
            }
        }

        // uint64_t scheduler_end_time = k_uptime_get(); // End measuring scheduler time
        // printk("Total scheduler overhead for macro cycle: %llu ms\n", scheduler_end_time - scheduler_start_time);

        current_tick = 0;

        
    }
    timing_stop();
}


// #include <stdio.h> // Needed for snprintf if used

/**
 * @brief Prints the contents of the scheduler table.
 */
void STBS_print_content() {
    // Constants for table formatting
    const char *table_header =  "| Tick | Task Name      | Execution Time | Priority |\n";
    const char *table_divider = "+------+----------------+----------------+----------+\n";

    // Check for empty scheduler table
    if (stbs.macro_cycle == 0) {
        printk("Scheduler table is empty.\n");
        return;
    }

    printk("Printing scheduler table contents:\n");
    printk("%s", table_divider);
    printk("%s", table_header);
    printk("%s", table_divider);

    for (int tick = 0; tick < stbs.macro_cycle; tick++) {
        if (entry[tick].num_tasks == 0) {
            // Print empty tick row
            printk("| %4d | %-14s | %-14s | %-8s |\n", tick, "No tasks", "-", "-");
            continue;
        }

        for (int task_idx = 0; task_idx < entry[tick].num_tasks; task_idx++) {
            Task current_task = entry[tick].tasks[task_idx];
            
            // Print task row
            printk("| %4d | %-14s | %-14d | %-8d |\n", 
                tick, 
                current_task.name, 
                current_task.exec_time,  
                current_task.priority    
            );
        }

        // Print total execution time row for this tick
        printk("| %4s | %-14s | %-14d | %-8s |\n", 
            "-", 
            "Total Time", 
            entry[tick].total_exec_time, 
            "-"
        );
        printk("%s", table_divider);
    }
}

void STBS_destroy(){
    for (int i = 0; i < stbs.macro_cycle; i++) {
        k_free(entry[i].tasks);
    }
    k_free(entry);

     // Free the task table and reset fields
    if (stbs.task_table) {
        k_free(stbs.task_table);
        stbs.task_table = NULL;
    }
    stbs.num_tasks = 0;
    stbs.macro_cycle = 0;
}


// testing functions
int STBS_GetNumTasks(void) {
    return stbs.num_tasks;
}

int STBS_GetTickMs(void) {
    return stbs.tick_ms;
}

const Task* STBS_GetTaskTable(void) {
    return stbs.task_table;
}

int STBS_GetMacroCycle(void) {
    return stbs.macro_cycle;
}
```

## src/stb_scheduler.h
```c
#include "functions.h"


// Scheduler structure to manage tasks and execution
typedef struct {
    int tick_ms;                 // Scheduler tick duration in milliseconds
    Task *task_table;  // Array of tasks
    int max_tasks;               // Maximum number of tasks allowed
    int num_tasks;               // Current number of tasks
    int macro_cycle;              // Macrocycle duration (in ticks)
} STB_scheduler;

typedef struct{
    // int tick;               // current tick
    Task *tasks;  // ids of the tasks that will execute in this tick
    int num_tasks;          // number of tasks to execute in this tick
    int total_exec_time;    // total time it takes for the tasks to execute
}scheduler_table_entry;


static STB_scheduler stbs; // Global scheduler instance
static scheduler_table_entry *entry;


void STBS_Init(int tick_ms, int max_tasks) {
    stbs.tick_ms = tick_ms;
    stbs.max_tasks = max_tasks;
    stbs.num_tasks = 0;
    stbs.task_table = k_malloc(max_tasks * sizeof(Task));
    // Initialize task table
    for (int i = 0; i < max_tasks; i++) {
        stbs.task_table[i].id = -1; // Mark as unused
        stbs.task_table[i].ticks = 0;
        stbs.task_table[i].next_activation = -1;
    }

    // Initialize the Zephyr timer
    // k_timer_init(&stbs.scheduler_timer, scheduler_timer_handler, NULL);
    printk("STBS Initialized\n");
}

/**
 * Adds a new task to the scheduler.
 */
void STBS_AddTask(int ticks, k_tid_t task_id, int priority, int execution_time, char *name) {
    if (stbs.num_tasks >= stbs.max_tasks) {
        printk("Error: Maximum task limit reached\n");
        return;
    }

    // Find an empty slot in the task table
    for (int i = 0; i < stbs.max_tasks; i++) {
        if (stbs.task_table[i].id == -1) {
            stbs.task_table[i].ticks = ticks;
            stbs.task_table[i].next_activation = ticks; // Set initial activation
            stbs.task_table[i].priority = priority;
            stbs.task_table[i].id = task_id;
            stbs.task_table[i].exec_time = execution_time;
            stbs.task_table[i].to_be_executed = 0;
            stbs.task_table[i].name = name;

            // Allocate memory for thread stack
            //char *stack_area = k_malloc(K_THREAD_STACK_SIZEOF(512));
            //if (stack_area == NULL) {
            //    printk("Error: Failed to allocate thread stack\n");
            //    return;
            //}

            // Create and start the thread
            //stbs.task_table[i].thread_id = k_thread_create(
            //    &stbs.task_table[i].thread,
            //    stack_area, 512,
            //    task_function,
            //    &stbs.task_table[i].id, NULL, NULL,
            //    priority,
            //    0, K_NO_WAIT);
           
            

            stbs.num_tasks++;
            printk("Added Task %d with period %d ticks\n", task_id, ticks);
            break;
        }
    }
}

/**
 * Starts the scheduler by activating the timer and calculating the macrocycle.
 */
// void STBS_Start() {
//     int64_t fin_time=0, release_time=0;     /* Timing variables to control task periodicity */

//     // Calculate macrocycle as the LCM of all task periods
//     int task_ticks[stbs.max_tasks];
//     for (int i = 0; i < stbs.num_tasks; i++) {
//         task_ticks[i] = stbs.task_table[i].ticks;
//         printk("Thread id: %d\n", stbs.task_table[i].id);
//     }
//     stbs.macro_cycle = lcm_array(task_ticks, stbs.num_tasks);
//     printk("Macrocycle calculated: %d ticks\n", stbs.macro_cycle);

//     printk("Starting STBS\n");
//     release_time = k_uptime_get() + stbs.tick_ms;
//     int current_tick = 0; // Keeps track of the current tick count
//     while(1){
//         current_tick++;

//         // Log when a macrocycle completes
//         // if (current_tick % stbs.macroCycle == 0) {
//         //     printk("End of macrocycle at tick %d\n", current_tick);
//         // }

//         // Check each task for activation
//         for (int i = 0; i < stbs.num_tasks; i++) {
//             if (current_tick == stbs.task_table[i].next_activation) {
//                 printk("Activating Task %d\n", stbs.task_table[i].id);
//                 stbs.task_table[i].next_activation += stbs.task_table[i].ticks; // Schedule next activation
//                 k_thread_resume(stbs.task_table[i].id);
                
//             }
//         }


//         fin_time = k_uptime_get();
//         if( fin_time < release_time) {
//             k_msleep(release_time - fin_time);
//             release_time += stbs.tick_ms;

//         }
//     }
//     timing_stop();
// }

void STBS_Start() {
    int64_t fin_time=0, release_time=0;     /* Timing variables to control task periodicity */

    // Calculate macrocycle as the LCM of all task periods
    int task_ticks[stbs.max_tasks];
    for (int i = 0; i < stbs.num_tasks; i++) {
        task_ticks[i] = stbs.task_table[i].ticks;
        printk("Thread id: %d\n", stbs.task_table[i].id);
    }
    stbs.macro_cycle = lcm_array(task_ticks, stbs.num_tasks);
    printk("Macrocycle calculated: %d ticks\n", stbs.macro_cycle);
    

    // Calculate the ticks in which each task will execute
    qsort(stbs.task_table,stbs.num_tasks,sizeof(Task),compare_tasks);

    // debug
    for (int i = 0; i < stbs.num_tasks; i++) {
        printk("prio: %d, ticks: %d\n", stbs.task_table[i].priority, stbs.task_table[i].ticks);
    }

    // create the table with the times in which each task will execute
    // in the first tick, all taks are ready
    // entry = k_malloc(stbs.macro_cycle * sizeof(scheduler_table_entry));
    entry = k_malloc(stbs.macro_cycle * sizeof(scheduler_table_entry));
    if (!entry) {
        printk("Failed to allocate scheduler table\n");
        return;
    }

    for(int j = 0; j< stbs.macro_cycle;j++){
        entry[j].num_tasks = 0;
        // entry[j].tick = j;
        entry[j].tasks = k_malloc(stbs.num_tasks*sizeof(Task));
        if (!entry[j].tasks) {
            printk("Failed to allocate memory for tasks at tick %d\n", j);
            // Free previously allocated entries to prevent memory leaks
            for (int k = 0; k < j; k++) {
                k_free(entry[k].tasks);
            }
            k_free(entry);
            return;
        }
        entry[j].total_exec_time = 0;

    }
    // for(int j = 0; j<stbs.num_tasks; j++){
    //     if(stbs.task_table[j].exec_time+entry[0].total_exec_time <= stbs.tick_ms){
    //         entry[0].task_id_list[entry[0].num_tasks] = stbs.task_table[j].id;
    //         entry[0].total_exec_time += stbs.task_table[j].exec_time;
    //         entry[0].num_tasks++;
    //     }
    //     else{
    //         entry[0+1].task_id_list[entry[0+1].num_tasks] = stbs.task_table[j].id;
    //         entry[0+1].total_exec_time += stbs.task_table[j].exec_time;
    //         entry[0+1].num_tasks;
    //     }
            
    // }
    printk("Starting table computation\n");
    // compute the next ticks
    for(int tick = 0; tick < stbs.macro_cycle;tick++){
        // printk("\ncurrent_tick: %d\n",tick);

        for(int task_idx = 0; task_idx < stbs.num_tasks; task_idx++){
            if(tick == 0 || tick % stbs.task_table[task_idx].ticks == 0 || stbs.task_table[task_idx].to_be_executed){
                // printk("total_exec_time: %d, task_exec_time: %d\n",entry[tick].total_exec_time,stbs.task_table[task_idx].exec_time);
                if(stbs.task_table[task_idx].exec_time + entry[tick].total_exec_time <= stbs.tick_ms){
                    entry[tick].tasks[entry[tick].num_tasks] = stbs.task_table[task_idx];
                    entry[tick].total_exec_time += stbs.task_table[task_idx].exec_time;
                    entry[tick].num_tasks++;
                    stbs.task_table[task_idx].to_be_executed = 0;
                    // printk("Added '%s' to tick: %d\n",stbs.task_table[task_idx].name,tick);
                }
                else{
                    if(tick+1 > stbs.macro_cycle){
                        printk("System not schedulable\n");
                        for (int i = 0; i < stbs.macro_cycle; i++) {
                            k_free(entry[i].tasks);
                        }
                        k_free(entry);
                        return;
                    }
                    stbs.task_table[task_idx].to_be_executed = 1;
                    // entry[tick+1].task_id_list[entry[tick+1].num_tasks] = stbs.task_table[task_idx].id;
                    // entry[tick+1].total_exec_time += stbs.task_table[task_idx].exec_time;
                    // entry[tick+1].num_tasks++;
                    // printk("Added task: %d to tick: %d\n",task_idx,tick+1);

                }
            }
            
            
        }
    }
    STBS_print_content();

    // for (int i = 0; i < stbs.num_tasks; i++) {
    //     entry[0].task_id_list
    //     for(int j = 1; j<stbs.macro_cycle;j++){
    //         if(j%)
    //     }

    // }

    printk("Starting STBS\n");
    int current_tick = 0; // Keeps track of the current tick count
    int count = 0; // Keeps track of the current tick count
    k_msleep(20); // let the tasks arrive at the point where they suspend themselves
    while(1){

        // Log when a macrocycle completes
        // if (current_tick % stbs.macroCycle == 0) {
        //     printk("End of macrocycle at tick %d\n", current_tick);
        // }
        release_time = k_uptime_get() + stbs.tick_ms;
        for(int i = 0; i <stbs.macro_cycle;i++){
            // Check each task for activation
            current_tick++;
            printk("i: %d\n",i);
            for(int task_idx = 0; task_idx < entry[i].num_tasks; task_idx++){
                k_tid_t task_id = entry[i].tasks[task_idx].id;
                // printk("Activating Task %d\n", task_id);
                k_thread_resume(task_id);
            }
            // for (int j = 0; j < stbs.num_tasks; j++) {
            //     if (current_tick == stbs.task_table[j].next_activation) {
            //         printk("Activating Task %d\n", stbs.task_table[j].id);
            //         stbs.task_table[j].next_activation += stbs.task_table[j].ticks; // Schedule next activation
            //         k_thread_resume(stbs.task_table[j].id);
                    
            //     }

            // }
            fin_time = k_uptime_get();
            if( fin_time < release_time) {
                k_msleep(release_time - fin_time);
                release_time += stbs.tick_ms;
            }
            // for (int j = 0; j < stbs.num_tasks; j++) {
            //     if (current_tick == stbs.task_table[j].next_activation) {
            //         printk("Activating Task %d\n", stbs.task_table[j].id);
            //         stbs.task_table[j].next_activation += stbs.task_table[j].ticks; // Schedule next activation
            //         k_thread_resume(stbs.task_table[j].id);
                    
            //     }

            // }
            // fin_time = k_uptime_get();
            // if( fin_time < release_time) {
            //     k_msleep(release_time - fin_time);
            //     release_time += stbs.tick_ms;
            // }

        }
        current_tick = 0;
        count++;
        // k_msleep(5000);
        if(count == 2)
            break;

        
    }
    timing_stop();
}


// #include <stdio.h> // Needed for snprintf if used

void STBS_print_content() {
    // Constants for table formatting
    const char *table_header =  "| Tick | Task Name      | Execution Time | Priority |\n";
    const char *table_divider = "+------+----------------+----------------+----------+\n";

    // Check for empty scheduler table
    if (stbs.macro_cycle == 0) {
        printk("Scheduler table is empty.\n");
        return;
    }

    printk("Printing scheduler table contents:\n");
    printk("%s", table_divider);
    printk("%s", table_header);
    printk("%s", table_divider);

    for (int tick = 0; tick < stbs.macro_cycle; tick++) {
        if (entry[tick].num_tasks == 0) {
            // Print empty tick row
            printk("| %4d | %-14s | %-14s | %-8s |\n", tick, "No tasks", "-", "-");
            continue;
        }

        for (int task_idx = 0; task_idx < entry[tick].num_tasks; task_idx++) {
            Task current_task = entry[tick].tasks[task_idx];
            
            // Print task row
            printk("| %4d | %-14s | %-14d | %-8d |\n", 
                tick, 
                current_task.name, 
                current_task.exec_time,  // Replace with actual field
                current_task.priority    // Replace with actual field
            );
        }

        // Print total execution time row for this tick
        printk("| %4s | %-14s | %-14d | %-8s |\n", 
            "-", 
            "Total Time", 
            entry[tick].total_exec_time, 
            "-"
        );
        printk("%s", table_divider);
    }
}

void STBS_destroy(){

}
```

## src/test_functions.h
```c
#ifndef FUNCTIONS_H
#define FUNCTIONS_H

#include "zephyr/kernel/thread.h"
#include <zephyr/kernel.h>
#include <zephyr/sys/printk.h>

// Constants
#define NS_IN_SEC 1000000000L  // Number of nanoseconds in a second (useful for time calculations)

// Structure to represent a Task
typedef struct {
    k_tid_t id;                      // Unique identifier for the task
    int ticks;                   // Task's period in ticks (relative to the scheduler's tick)
    int next_activation;         // Tick count for the next activation of the task
    struct k_thread thread;      // Zephyr thread object to manage the task's execution
    k_tid_t thread_id;           // Identifier for the thread
    int priority;                // Priority level of the thread (lower values = higher priority in Zephyr)
} Task;

// Inline Functions

/**
 * Compares two tasks based on their period (ticks).
 * 
 * Used for sorting tasks in ascending order of their period.
 *
 * @param a Pointer to the first task
 * @param b Pointer to the second task
 * @return Negative value if a < b, zero if a == b, positive value if a > b
 */
static inline int compare_tasks(const void *a, const void *b) {
    const Task *taskA = (const Task *)a;
    const Task *taskB = (const Task *)b;
    return taskA->ticks - taskB->ticks; // Sort by period (ascending order)
}

/**
 * Calculates the Greatest Common Divisor (GCD) of two integers.
 * 
 * Useful for determining relationships between task periods.
 *
 * @param a First integer
 * @param b Second integer
 * @return The GCD of the two integers
 */
static inline int gcd(int a, int b) {
    while (b != 0) {
        int temp = b;
        b = a % b;
        a = temp;
    }
    return a;
}

/**
 * Calculates the Least Common Multiple (LCM) of two integers.
 * 
 * Used to compute the macrocycle of the scheduler.
 *
 * @param a First integer
 * @param b Second integer
 * @return The LCM of the two integers
 */
static inline int lcm(int a, int b) {
    return (a * b) / gcd(a, b);
}

/**
 * Calculates the Least Common Multiple (LCM) of an array of integers.
 * 
 * Helps determine the scheduler's macrocycle by finding the LCM of all task periods.
 *
 * @param arr Array of integers representing task periods
 * @param n Number of elements in the array
 * @return The LCM of the array (macrocycle duration)
 */
static inline int lcm_array(int arr[], int n) {
    int result = arr[0];
    for (int i = 1; i < n; i++) {
        result = lcm(result, arr[i]);
    }
    return result;
}

#endif // FUNCTIONS_H
```
