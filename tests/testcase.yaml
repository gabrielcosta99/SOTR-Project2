## tests/testcase.yaml
```yaml
tests:
  unit.stbs.test_stb_scheduler:
    tags: stbs
    type: unit
    timeout: 60
    platform_allow:
      - native_posix
      
    toolchain_allow:
      - zephyr
      - gnuarmemb
```
